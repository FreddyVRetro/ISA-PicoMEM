
#include <stdio.h>
#include <string.h>
#include "pico/stdlib.h"

#include "pm_board.h"     // PicoMEM Board Definitions (GPIO)
#include "../pm_debug.h"
#include "ff.h"           // forr FIL definition
#include "pm_defines.h"

#include "dev_oled.h"
#include "pm_i2c.h"
#include "pm_display.h"

#include "dev_audiomix.h"
#include "picoOled.h"

pm_display_t pm_display;

bool screen_active;

 /* Standard ASCII 6x8_AB font */
 const uint8_t oled_font6x8_AB []=
 {
   0x06, 0x08, 0x20, 0x20+64,
   0x00, 0x00, 0x00, 0x00, 0x00, 0x00, // sp
   0x00, 0x00, 0x00, 0x2f, 0x00, 0x00, // !
   0x00, 0x00, 0x07, 0x00, 0x07, 0x00, // "
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   0x00, 0x00, 0x01, 0x02, 0x04, 0x00, // '
   0x00 /* This byte is required for italic type of font */
 };

const uint8_t oled_font8x16[] = {
     0x08, 0x10, 0x20, 0x20 + 102,
     0x00, 0x00, 0x00, 0x00, 0x00, 0x00, 0x00, 0x00, 0x00, 0x00, 0x00, 0x00, 0x00, 0x00, 0x00, 0x00, //   0
     0x00, 0x00, 0x00, 0xF8, 0x00, 0x00, 0x00, 0x00, 0x00, 0x00, 0x00, 0x33, 0x30, 0x00, 0x00, 0x00, // ! 1
     0x00, 0x10, 0x0C, 0x06, 0x10, 0x0C, 0x06, 0x00, 0x00, 0x00, 0x00, 0x00, 0x00, 0x00, 0x00, 0x00, // " 2
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     0x00, 0x06, 0x01, 0x01, 0x02, 0x02, 0x04, 0x04, 0x00, 0x00, 0x00, 0x00, 0x00, 0x00, 0x00, 0x00, // ~ 94
 };

const uint8_t oled_font_digit_11x16 [] = { 
     11, 16, 32, 64,
     0x00, 0x00, 0x00, 0x00, 0x00, 0x00, 0x00, 0x00, 0x00, 0x00, 0x00, 0x00, 0x00, 0x00, 0x00, 0x00, 0x00, 0x00, 0x00, 0x00, 0x00, 0x00,  // char  
     0x00, 0x00, 0x00, 0x00, 0xFE, 0xFE, 0xFE, 0x00, 0x00, 0x00, 0x00, 0x00, 0x00, 0x00, 0x00, 0x18, 0x19, 0x18, 0x00, 0x00, 0x00, 0x00,  // char !
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     0x00, 0x00, 0xF8, 0x04, 0xC2, 0x22, 0x22, 0xFC, 0x00, 0x00, 0x00, 0x00, 0x00, 0x0F, 0x10, 0x21, 0x22, 0x22, 0x13, 0x00, 0x00, 0x00,  // char @  
};


const uint8_t oled_calibri11x12[] =
 {
 //  type|width|height|first char
     0x0B, 0x0A, 0x20, 0x20+125,
     0x00, 0x00, 0x00, 0x00, // char ' ' (0x0020/32)
     0x00, 0x00, 0x02, 0x08, // char '!' (0x0021/33)
     0x00, 0x02, 0x03, 0x04, // char '"' (0x0022/34)
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     0x01, 0xC9, 0x06, 0x08, // char '' (0x007F/127)
 };


 const uint8_t oled_font8x8mdos[] = { 
   //  type|width|height|first char
    8, 8, 32, 126,
   	0x00, 0x00, 0x00, 0x00, 0x00, 0x00, 0x00, 0x00,
    0x00, 0x00, 0x06, 0x5f, 0x5f, 0x06, 0x00, 0x00,
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    0x02, 0x03, 0x01, 0x03, 0x02, 0x03, 0x01, 0x00
};



void oled_init(t_OledParams *oled,uint8_t oled_type) {
   if (oled_type==OLED_SH1106_64)
      {
       PM_INFO("OLED : SH1106 132x64\n");            
       oled->ctlrType    = CTRL_SH1106; // CTRL_SSD1306
       oled->height      = H_64;
       oled->width       = W_132; //W_128
      } 
       else if (oled_type==OLED_SSD1306_32)
      {
       PM_INFO("OLED : SSD1306 128x32\n");
       oled->ctlrType    = CTRL_SSD1306;
       oled->height      = H_32;
       oled->width       = W_128;
      } else if (oled_type==OLED_SSD1306_64)
      {
       PM_INFO("OLED : SSD1306 128x64\n");
       oled->ctlrType    = CTRL_SSD1306;
       oled->height      = H_64;
       oled->width       = W_128;
      } else return;
   oled->i2c         = FP_I2C;
   oled->SDA_PIN     = FP_SDA;
   oled->SCL_PIN     = FP_SCL;

// Initialize the I2C I/O
   i2c_init(oled->i2c, 200000);
//    i2c_init(oled->i2c, 400000);
   gpio_init(oled->SDA_PIN);
   gpio_init(oled->SCL_PIN);
   gpio_set_function(oled->SDA_PIN, GPIO_FUNC_I2C);
   gpio_set_function(oled->SCL_PIN, GPIO_FUNC_I2C);
   gpio_pull_up(oled->SDA_PIN);
   gpio_pull_up(oled->SCL_PIN);

   PM_INFO("OLED I2C configured on pins %d (SDA) and %d (SCL)\n", oled->SDA_PIN, oled->SCL_PIN); 
   oled->enabled = false;

   if (pico_i2c_ping_device(oled->i2c, 0x3C))
     {  
      oled->i2c_address = 0x3C;
      oled->enabled     = true;
      PM_INFO("Start OLED : %d, h%d w%d\n", oled->ctlrType,oled->height,oled->width);
      // this will configure the OLED module and then clear the screen.
      oledI2cConfig(oled);
     }
}


bool pm_display_init(uint8_t oled_type)
{

 oled_init(&dev_oled_screen,oled_type);
//    dev_oled_init(&dev_oled_screen,OLED_SH1106_64);
 if (dev_oled_screen.enabled) {
        PM_INFO("OLED Screen detected and initialized\n");
        screen_active = true;
    } else {
        PM_INFO("OLED Screen not detected\n");
        screen_active = false;
    }

 if (screen_active) // Draw the initial screen
   {
    oledClear(&dev_oled_screen, BLACK);

//   oledDraw_img(&dev_oled_screen,0,0,24,24,oled_elephant_24x24,false);
     oledDraw_img(&dev_oled_screen,0,0,38,32,oled_elephant_38x32,false);
//    oledDraw_img(&dev_oled_screen,0,0,32,32,oled_info_32x32,false);
//    oledDraw_img(&dev_oled_screen,42,0,39,32,oled_GMIDI_39x32,false);
//oledDraw_img(&dev_oled_screen,0,0,68,32,oled_sblaster_68x32,false);
//oledDraw_img(&dev_oled_screen,70,0,32,32,oled_floppy_32x32,false);

    oled_setfont(oled_font8x16);
    const char *buf1 = "PicoMEM";
    if (oled_font.height>8) oledDraw_string(&dev_oled_screen,48 ,LINE_1-4 , buf1, WHITE);
    
    oled_setfont(oled_font6x8);
    const char *buf2 = "I'm alive !";
    oledDraw_string(&dev_oled_screen, 48, LINE_3, buf2, WHITE);

    oledDisplay(&dev_oled_screen);
    pm_display_contrast(CONTRAST_HIGH);
    pm_display.hc_delay=50;   // (5s before going low)
    pm_display.temporary_screen=false;
    
   }
  return screen_active;
}

void pm_display_img_list(uint8_t img_index, uint8_t img_list_nb, FSizeName_t *pm_img_list)
{
 uint8_t line_per_page=dev_oled_screen.height/8;
 uint8_t page_index=img_index/line_per_page;

 pm_display.screen=D_IMG_LIST; // Need to update every time, No check

 char buf[20];
 PM_INFO("Display image list, index %d/%d, page %d\n",img_index,img_list_nb,page_index);
 PM_INFO("%s\n",pm_img_list[0].name); 

 uint8_t x=4;
 oled_setfont(oled_font8x8mdos);
 //oled_setfont(oled_font6x8);
 oledDraw_rectangle(&dev_oled_screen, 0, 0, dev_oled_screen.width-1, dev_oled_screen.height-1, SOLID, BLACK);

 for (uint8_t i=line_per_page*page_index;i<line_per_page*(page_index+1);i++)
   {
    if (i<img_list_nb)
      {
       char *imgname=pm_img_list[i].name;
       PM_INFO("Displaying image %d: %s\n", i, imgname);
       if ((i==img_index)&(pm_img_list[i].size==0xFFFE)) sprintf(buf,">%-13s]",imgname);
          else if (pm_img_list[i].size==0xFFFE) sprintf(buf,"[%-13s]",imgname);           // Folder name
            else if (i==img_index) sprintf(buf,">%-13s<",imgname);
              else sprintf(buf," %s ",imgname);                                           // Regular image
       oledDraw_string(&dev_oled_screen,x ,(i-(line_per_page*page_index))*8 ,buf , WHITE);
      }
   }

  oledDisplay(&dev_oled_screen);
  pm_display_contrast(CONTRAST_HIGH);
  pm_display.hc_delay=80;   // (8s before going low)
}

void pm_display_floppy_confirm(uint8_t choice)
{
  pm_display.screen=D_FDD_CONF; // Not called multiple time, No check  
  oledClear(&dev_oled_screen, BLACK);
//  oledDraw_rectangle(&dev_oled_screen, 4*8-2, 6, 20*8+2, 32-6,SOLID, BLACK);
//  oledDraw_rectangle(&dev_oled_screen, 4*8-2, 6, 20*8+2, 32-6,HOLLOW, WHITE );
  oled_setfont(oled_font8x8mdos);
  const char *buf1 = "- Mount Floppy -";
  oledDraw_line(&dev_oled_screen, 0, 10, dev_oled_screen.width-1, 10, WHITE);
  oledDraw_string(&dev_oled_screen,0 ,0 , buf1, WHITE);  
  const char *buf2 = "Drive A:";
  oledDraw_string(&dev_oled_screen,5*8 ,8*2 , buf2, WHITE);
  const char *buf3 = "Drive B:";
  oledDraw_string(&dev_oled_screen,5*8 ,8*3 , buf3, WHITE);  
  const char *buf4 = ">";
  if (choice==0) oledDraw_string(&dev_oled_screen,4*8 ,8*2 , buf4, WHITE);
    else oledDraw_string(&dev_oled_screen,4*8 ,8*3 , buf4, WHITE);
  oledDisplay(&dev_oled_screen);
  pm_display_contrast(CONTRAST_HIGH);
  pm_display.hc_delay=50;   // (5s before going low)
} 

// PicoMEM Home Screen : Displayed after boot
void pm_display_pmhome()
{
  if (pm_display.screen!=D_PMHOME)
  {
    pm_display.prev_screen=pm_display.screen;
    pm_display.screen=D_PMHOME;

    oledClear(&dev_oled_screen, BLACK);
    oledDraw_img(&dev_oled_screen,0,0,38,32,oled_elephant_38x32,false);

    oled_setfont(oled_font8x16);
    const char *buf1 = "PicoMEM";
    oledDraw_string(&dev_oled_screen,50 ,LINE_0 , buf1, WHITE);

    oled_setfont(oled_font6x8);
    const char *buf2 = "Up/Dn: Menus";
    oledDraw_string(&dev_oled_screen, 8*5, LINE_2, buf2, WHITE);

    oledDisplay(&dev_oled_screen);
    pm_display_contrast(CONTRAST_HIGH);
    pm_display.hc_delay=50;   // (5s before going low)
  }   
}

void pm_display_pmpost_event(uint8_t code)
{
  if (!dev_oled_screen.enabled) return;
  if (code==0) return;  // Ignore POST Code 0
  if (pm_display.screen!=D_PMPOST)
  {
    pm_display.prev_screen=pm_display.screen;
    pm_display.screen=D_PMPOST;
    oledClear(&dev_oled_screen, BLACK);
    oledDraw_img(&dev_oled_screen,0,0,38,32,oled_elephant_38x32,false);

    oled_setfont(oled_font8x16);
    const char *buf1 = "PicoMEM";
    oledDraw_string(&dev_oled_screen,50 ,LINE_0 , buf1, WHITE);
  }
    char poststr[12];
    switch(code)
       {
        case 0x01: strcpy(&poststr[0],"INIT       "); break;
        case 0x02: strcpy(&poststr[0],"TST PORT   "); break;
        case 0x03: strcpy(&poststr[0],"TST RAM    "); break;
        case 0x04: strcpy(&poststr[0],"WAIT PMINIT"); break;
        case 0x05: strcpy(&poststr[0],"TST RAMCMD "); break;
        case 0x11: strcpy(&poststr[0],"DETECT IRQ "); break;        
        case 0x12: strcpy(&poststr[0],"CHK PREBOOT"); break;
        case 0x13: strcpy(&poststr[0],"CFG BOOTSTR"); break;
        case 0x30: strcpy(&poststr[0],"MENU START "); break;
        case 0x32: strcpy(&poststr[0],"SETUP MENU "); break;
        case 0x3F: strcpy(&poststr[0],"MENU END   "); break;
        case 0x20: strcpy(&poststr[0],"INIT END   "); break;
        case 0x40: strcpy(&poststr[0],"SAVE CFG   "); break;
        case 0x41: strcpy(&poststr[0],"MEM INIT   "); break;        
        case 0x42: strcpy(&poststr[0],"DEV INIT   "); break;
        case 0x43: strcpy(&poststr[0],"INST HWIRQ "); break;
        case 0x45: strcpy(&poststr[0],"INST INT13h"); break;
        case 0x4F: strcpy(&poststr[0]," SETUP END "); break;
        case 0x60: strcpy(&poststr[0],"START SETUP"); break;
        case 0x61: strcpy(&poststr[0],"CONF DETECT"); break;
        case 0x62: strcpy(&poststr[0],"MEM DETECT "); break;
        case 0x63: strcpy(&poststr[0],"DISP HEADER"); break;
        case 0x64: strcpy(&poststr[0],"SETUP KEY  "); break;
        case 0x50: strcpy(&poststr[0],"BOOT KEY   "); break;
        case 0x51: strcpy(&poststr[0],"  ROM BOOT "); break;
        case 0x52: strcpy(&poststr[0],"  FDD BOOT "); break;
        case 0x53: strcpy(&poststr[0],"  HDD BOOT "); break;
        case 0x55: strcpy(&poststr[0],"  BOOT OS  "); break;
        case 0x80: strcpy(&poststr[0],"PORT Error "); break;
        case 0x81: strcpy(&poststr[0],"RAM Error  "); break;
        case 0x82: strcpy(&poststr[0],"Cmd Failure"); break;
        case 0x85: strcpy(&poststr[0]," BOOT Fail "); break;
        case 0x86: strcpy(&poststr[0],"  BAD MBR  "); break;
        default:
                   sprintf(&poststr[0],"POST :%2X  ",code); break;
       }
    oledDraw_rectangle(&dev_oled_screen, 40, LINE_2, 40+11*8, LINE_2 + 16, SOLID, BLACK);
    oledDraw_string(&dev_oled_screen, 40,LINE_2, poststr, WHITE);

    oledDisplay(&dev_oled_screen);
    pm_display_contrast(CONTRAST_HIGH);
    pm_display.hc_delay=50;   // (5s before going low)    
}

// POST Code Display : Launched every time there is a POST Code event
void pm_display_pcpost_event(uint8_t code,uint8_t code2)
{
  if (!dev_oled_screen.enabled) return;
  if (code==0) return;  // Ignore POST Code 0
  if (pm_display.screen!=D_PCPOST)
  {
    pm_display.prev_screen=pm_display.screen;
    pm_display.screen=D_PCPOST;
  
    oledClear(&dev_oled_screen, BLACK);
    oledDraw_img(&dev_oled_screen,0,0,39,32,oled_post_39x32,false);

    oled_setfont(oled_font8x16);
    const char *buf1 = "POST:";
    oledDraw_string(&dev_oled_screen,42 ,LINE_1 , buf1, WHITE);
  }

    char poststr[4];
    sprintf(&poststr[0],"%02X %02X",code,code2);
    oledDraw_rectangle(&dev_oled_screen, 42+5*8, LINE_1, 42+10*8, LINE_1 + 16, SOLID, BLACK);
    oledDraw_string(&dev_oled_screen, 42+5*8,LINE_1, poststr, WHITE);

    oledDisplay(&dev_oled_screen);
    pm_display_contrast(CONTRAST_HIGH);
    pm_display.hc_delay=50;   // (5s before going low)    
}

// Display PAD/Joytick event messages
void pm_display_pad_event(uint8_t code,char *msg)
{
  if (!dev_oled_screen.enabled) return;
  if (code==0) return;  // Ignore POST Code 0
  if (pm_display.screen!=D_PAD)
  {
    pm_display.prev_screen=pm_display.screen;
    pm_display.screen=D_PAD;
  
    oledClear(&dev_oled_screen, BLACK);
    oledDraw_img(&dev_oled_screen,0,0,32,32,oled_info_32x32,false);  // To do: To replace with PAD image

    oled_setfont(oled_font8x16);
    const char *buf1 = " * JOYPAD *";
    oledDraw_string(&dev_oled_screen,8*4 ,LINE_0 , buf1, WHITE);
  }

    oledDraw_rectangle(&dev_oled_screen, 42+5*8, LINE_1, 42+10*8, LINE_1 + 16, SOLID, BLACK);
    oledDraw_string(&dev_oled_screen, 42+5*8,LINE_1, msg, WHITE);

    oledDisplay(&dev_oled_screen);
    pm_display_contrast(CONTRAST_HIGH);
    pm_display.hc_delay=50;   // (5s before going low)    
}

// GMIDI Display : When GMIDI is detected, display the General MIDI Logo plus volume bar
void pm_display_gmidi()
{  
  if (pm_display.screen!=D_GMIDI)
  {
    pm_display.prev_screen=pm_display.screen;
    pm_display.screen=D_GMIDI;

    oledClear(&dev_oled_screen, BLACK);
    oledDraw_img(&dev_oled_screen,0,0,39,32,oled_GMIDI_39x32,false);

    oled_setfont(oled_font8x16);
    const char *buf1 = "GMIDI";
    oledDraw_string(&dev_oled_screen,70 ,LINE_1 , buf1, WHITE);

    oledDisplay(&dev_oled_screen);
    pm_display_contrast(CONTRAST_HIGH);    
  }
  }

void pm_display_sb()
{  
  if (pm_display.screen!=D_SB)
  {
    pm_display.prev_screen=pm_display.screen;
    pm_display.screen=D_SB;

    oledClear(&dev_oled_screen, BLACK);
    oledDraw_img(&dev_oled_screen,0,0,68,32,oled_sblaster_68x32,false);

    oled_setfont(oled_font8x16);
    const char *buf1 = "SB";
    oledDraw_string(&dev_oled_screen,100 ,LINE_1 , buf1, WHITE);

    oledDisplay(&dev_oled_screen);
    pm_display_contrast(CONTRAST_HIGH);    
  }
}

void pm_display_adlib()
{  
  if (pm_display.screen!=D_ADLIB)
  {
    pm_display.prev_screen=pm_display.screen;
    pm_display.screen=D_ADLIB;

    oledClear(&dev_oled_screen, BLACK);
    oledDraw_img(&dev_oled_screen,0,0,68,32,oled_sblaster_68x32,false);

    oled_setfont(oled_font8x16);
    const char *buf1 = "ADLIB";
    oledDraw_string(&dev_oled_screen,70 ,LINE_1 , buf1, WHITE);

    oledDisplay(&dev_oled_screen);
    pm_display_contrast(CONTRAST_HIGH);    
  }
}

void pm_display_gus()
{  
  if (pm_display.screen!=D_GUS)
  {
    pm_display.prev_screen=pm_display.screen;
    pm_display.screen=D_GUS;

    oledClear(&dev_oled_screen, BLACK);
    oledDraw_img(&dev_oled_screen,0,0,94,32,oled_gus_94x32,false);

    oled_setfont(oled_font8x16);
    const char *buf1 = "GUS";
    oledDraw_string(&dev_oled_screen,100 ,LINE_1 , buf1, WHITE);

    oledDisplay(&dev_oled_screen);
    pm_display_contrast(CONTRAST_HIGH);    
  }
}    

void pm_display_menu_floppy_select()
{  
  if (pm_display.screen!=D_FLOPPY_S)
  {
    pm_display.prev_screen=pm_display.screen;
    pm_display.screen=D_FLOPPY_S;

    oledClear(&dev_oled_screen, BLACK);
    oledDraw_img(&dev_oled_screen,0,0,32,32,oled_floppy_32x32,false);

    oled_setfont(oled_font8x16);
    const char *buf1 = " * FLOPPY *";
    oledDraw_string(&dev_oled_screen,8*4 ,LINE_0 , buf1, WHITE);

    oled_setfont(oled_font6x8);
    const char *buf2 = " Select Floppy";
    oledDraw_string(&dev_oled_screen, 8*4, LINE_2, buf2, WHITE);
//    const char *buf2 = "Up/Dn: Change";
//    oledDraw_string(&dev_oled_screen, 48, LINE_2, buf2, WHITE); 

    oledDisplay(&dev_oled_screen);
    pm_display_contrast(CONTRAST_HIGH);    
  }
}

void pm_display_menu_info_select()
{  
  if (pm_display.screen!=D_INFO_S)
  {
    pm_display.prev_screen=pm_display.screen;
    pm_display.screen=D_INFO_S;

    oledClear(&dev_oled_screen, BLACK);
    oledDraw_img(&dev_oled_screen,0,0,32,32,oled_info_32x32,false);

    oled_setfont(oled_font8x16);
    const char *buf1 = "*  INFO  *";
    oledDraw_string(&dev_oled_screen,8*5 ,LINE_0 , buf1, WHITE);

    oled_setfont(oled_font6x8);
    const char *buf2 = " Diplay Infos";
    oledDraw_string(&dev_oled_screen, 8*4, LINE_2, buf2, WHITE);

    oledDisplay(&dev_oled_screen);
    pm_display_contrast(CONTRAST_HIGH);    
  }
}

void pm_display_blink()
{
#ifdef OLED_ON 
    oledSet_invert(&dev_oled_screen, true);
    sleep_ms(1000);
    oledSet_invert(&dev_oled_screen, false);
    sleep_ms(1000);
#endif
}

void pm_display_prevScreen()
{
   switch(pm_display.prev_screen)
      {
       case D_GMIDI:
            pm_display_gmidi();
            break;
       case D_SB:
            pm_display_sb();
            break;
       case D_ADLIB:
            pm_display_adlib();
            break;
       case D_GUS:
            pm_display_gus();
            break;
       case D_PMHOME:         
            pm_display_pmhome();
            break;
       case D_FLOPPY_S:
          break;          
          }  
}

void pm_display_contrast(uint8_t contrast)
{
  if (contrast!=pm_display.contrast)
  {
   oledSet_contrast(&dev_oled_screen, contrast);
   pm_display.contrast=contrast;
  }
}

void pm_display_event(uint8_t ScreenID, uint8_t code1, uint8_t code2, char *event_msg)
{
  switch(ScreenID)
      {
       case D_PMPOST:
            pm_display_pmpost_event(code1);
            pm_display.temporary_screen=true;
            pm_display.temporary_delay=60;   // (6s before going back to previous screen)
            break;
       case D_PCPOST:
            pm_display_pcpost_event(code1,code2);
            pm_display.temporary_screen=true;
            pm_display.temporary_delay=60;   // (6s before going back to previous screen)            
            break;
       case D_PAD:
            pm_display_pad_event(code1,event_msg);
            pm_display.temporary_screen=true;
            pm_display.temporary_delay=60;   // (6s before going back to previous screen)            
            break;
       case D_GMIDI:
       case D_SB:
       case D_ADLIB:
       case D_GUS:
       case D_FLOPPY_S:
       case D_INFO_S:
       break;          
      }  
}

void pm_display_worker(uint32_t ms_since_last)
{
  static uint32_t pm_display_dev_active =0;

  if (!dev_oled_screen.enabled) return;
  if (pm_display.hc_delay--==0) pm_display_contrast(CONTRAST_LOW);

  if (dev_audiomix.dev_active!=pm_display_dev_active) {
   pm_display_dev_active=dev_audiomix.dev_active;
   if (pm_display_dev_active) {      
      pm_display.hc_delay=50;   // (5s before going low)
      PM_INFO("Audio Device Active : %04X\n",dev_audiomix.dev_active);
      if (dev_audiomix.dev_active & AD_ADLIB) {
         PM_INFO("AdLib detected\n");
         pm_display_adlib();      
      } else if (dev_audiomix.dev_active & AD_MPU) {
         PM_INFO("General MIDI detected\n");        
         pm_display_gmidi();
      }  else if (dev_audiomix.dev_active & AD_GUS) {
         PM_INFO("Gravis Ultrasound detected\n");
         pm_display_gus();
      } else if (dev_audiomix.dev_active & AD_SBDSP) {
         PM_INFO("Sound Blaster detected\n");
         pm_display_sb();
        }
      }
   } else {
     //Go back to the previous Display Screen if no more audio device active
   }

   // display the previous screen after temporary screen delay
   if (pm_display.temporary_screen)
      {
        if (pm_display.temporary_delay--==0)
          {
          pm_display_prevScreen();
          pm_display.temporary_screen=false;
         }
      }

   // Screen needing regular refresh
   switch(pm_display.screen)
      {
       case D_GMIDI:
            pm_display_gmidi();
            break;
       case D_SB:
            pm_display_sb();
            break;
       case D_ADLIB:
            pm_display_adlib();
            break;
       case D_GUS:
            pm_display_gus();
            break;
          break;
      }
}